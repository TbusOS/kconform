## tests/fixtures/uboot-demo/Kconfig
```kconfig
# Root Kconfig for the kconform test fixture.
#
# Symbol names use the generic ACME / DEMO prefixes so the fixture carries no
# vendor or product identity. Keep it that way.

mainmenu "kconform test fixture configuration"

config ACME_BOARD_SUPPORT
	bool "Enable ACME demo board support"
	default y
	help
	  Top-level toggle for the fixture. Always on in the clean defconfig.

config ACME_PLATFORM_NAME
	string "Human-readable platform name"
	default "acme-demo"
	help
	  Purely descriptive; emitted into the build banner in a real project.

menuconfig ACME_FEATURE_GROUP
	bool "ACME feature group"
	default y
	help
	  Declared with the `menuconfig` keyword rather than `config`. Both
	  forms are equivalent for kconform's ghost-symbol check; this fixture
	  includes one of each to make sure the detector covers both.

if ACME_FEATURE_GROUP

config ACME_FEATURE_ALPHA
	bool "Alpha sub-feature"
	default y

config ACME_FEATURE_BETA
	bool "Beta sub-feature"
	default n

endif

source "drivers/Kconfig"
```

## tests/fixtures/uboot-demo/cmd/Kconfig
```kconfig
# cmd/Kconfig for the kconform U-Boot fixture.
#
# Real U-Boot trees put command implementations under cmd/, with a Kconfig
# here declaring CONFIG_CMD_* symbols. This fixture ships a minimal version
# so the detector's `cmd/` marker is satisfied by something meaningful
# rather than an empty directory.

menu "Commands"

config CMD_DEMO_ECHO
	bool "Demo echo command"
	default y
	help
	  Example command symbol. The fixture only exists to exercise kconform's
	  platform detection — no real implementation.

endmenu
```

## tests/fixtures/uboot-demo/configs/demo_clean_defconfig
```kconfig
CONFIG_ACME_BOARD_SUPPORT=y
CONFIG_ACME_PLATFORM_NAME="acme-demo"
CONFIG_ACME_FEATURE_GROUP=y
CONFIG_ACME_FEATURE_ALPHA=y
CONFIG_DEMO_DRIVER_GPIO=y
CONFIG_DEMO_DRIVER_UART=y
```

## tests/fixtures/uboot-demo/configs/demo_ghost_defconfig
```kconfig
CONFIG_ACME_BOARD_SUPPORT=y
CONFIG_ACME_PLATFORM_NAME="acme-demo"
CONFIG_ACME_FEATURE_GROUP=y
CONFIG_ACME_FEATURE_ALPHA=y
CONFIG_DEMO_DRIVER_GPIO=y
# Two ghost symbols below: neither has a config/menuconfig declaration in the
# Kconfig tree, so kconform lint L001 should flag both.
CONFIG_ACME_MISSING_FEATURE=y
CONFIG_DEMO_GHOST_OPTION="unused"
```

## tests/fixtures/uboot-demo/configs/demo_non_standard_comment_defconfig
```kconfig
CONFIG_ACME_BOARD_SUPPORT=y
CONFIG_ACME_PLATFORM_NAME="acme-demo"
CONFIG_ACME_FEATURE_GROUP=y
CONFIG_ACME_FEATURE_ALPHA=y
CONFIG_DEMO_DRIVER_GPIO=y
CONFIG_CMD_DEMO_ECHO=y
# CONFIG_DEMO_DRIVER_STORAGE is not set
# Plain explanatory comment — this must not fire L002.
# CONFIG_ACME_FEATURE_BETA=y
#   CONFIG_DEMO_DRIVER_UART=y
```

## tests/fixtures/uboot-demo/drivers/Kconfig
```kconfig
# drivers/Kconfig — declares driver symbols for the fixture.

menu "Demo drivers"

config DEMO_DRIVER_GPIO
	bool "Demo GPIO driver"
	default y

config DEMO_DRIVER_UART
	bool "Demo UART driver"
	default y

config DEMO_DRIVER_STORAGE
	bool "Demo storage driver"
	default n

endmenu
```
